## components/WTask/Kconfig
```kconfig
menu "WTask Configuration"
    config WORKQUEUE_SUPPORT
        bool "Support WorkQueue"
        default y
        depends on RTASK_SUPPORT
        help
            Enable this option if you want to use WorkQueue object (WorkQueue depends on RTask).
            Disable this option to save memory.

    config RTASK_SUPPORT
        bool "Support RTask"
        default y
        depends on NTASK_SUPPORT
        help
            Enable this option if you want to use RTask object (RTask depends on NTask).
            Disable this option to save memory.

    config NTASK_SUPPORT
        bool "Support NTask"
        default y
        depends on TASK_SUPPORT
        help
            Enable this option if you want to use NTask object (NTask depends on Task).
            Disable this option to save memory.
    
    config TASK_SUPPORT
        bool "Support Task"
        default y
        help
            Enable this option if you want to use Task object (NTask depends on Task).
            Disable this option to save memory.
    
endmenu
```

## components/fixedpoint/Kconfig
```kconfig
menu "FixedPoint configuration"
    config FIXEDPOINT_FLOAT_SUPPORTED
        bool "Enable float support : aka operation with float"
        default 1
        help
            All classic operations (+ - * / and (cast)) with double type
            Prefer double support over float support when you want your application to run without FPU,
            because double is done using software

    config FIXEDPOINT_DOUBLE_SUPPORTED
        bool "Enable double support : aka operation with double"
        default 0
        help
            All classic operations (+ - * / and (cast)) with double type
            Prefer double support over float support when you want your application to run without FPU,
            because double is done using software
endmenu
```

## components/miscellaneous/Kconfig
```kconfig
menu "Miscellaneous Configuration"
    choice MISC_HEX_BUFF_COLOR_CHOICE
        prompt "Color for ISR safe printf function in console"
        depends on LOG_COLORS
        default MISC_LOG_COLOR_BLUE
        help
            Define the color of the ISR safe printing functions
        config MISC_LOG_COLOR_BLACK
            bool "Black"
        config MISC_LOG_COLOR_RED
            bool "Red"
        config MISC_LOG_COLOR_GREEN
            bool "Green"
        config MISC_LOG_COLOR_BROWN
            bool "Brown"
        config MISC_LOG_COLOR_BLUE
            bool "Blue"
        config MISC_LOG_COLOR_PURPLE
            bool "Purple"
        config MISC_LOG_COLOR_CYAN
            bool "Cyan"
    endchoice

    config MISC_HEX_BUFF_COLOR
        string
        default "30" if MISC_LOG_COLOR_BLACK
        default "31" if MISC_LOG_COLOR_RED
        default "32" if MISC_LOG_COLOR_GREEN
        default "33" if MISC_LOG_COLOR_BROWN
        default "34" if MISC_LOG_COLOR_BLUE
        default "35" if MISC_LOG_COLOR_PURPLE
        default "36" if MISC_LOG_COLOR_CYAN
endmenu
```
